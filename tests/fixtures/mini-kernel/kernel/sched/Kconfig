## tests/fixtures/mini-kernel/kernel/sched/Kconfig
```kconfig
config SCHED_DEBUG
    bool "Scheduler Debugging"
    help
      This option enables debugging output from the scheduler.
      If you are unsure, say N.

config SCHEDSTATS
    bool "Collect scheduler statistics"
    depends on SCHED_DEBUG
    help
      This feature enables the collection of scheduler statistics.

config SMP
    bool "Symmetric multi-processing support"
    help
      This enables support for systems with more than one CPU.

config SCHED_MC
    bool "Multi-core scheduler support"
    depends on SMP
    help
      This option enables the multi-core scheduler.

config SCHED_SMT
    bool "SMT (Hyperthreading) scheduler support"
    depends on SMP
    help
      This option enables the SMT scheduler.

menu "Scheduler features"
    depends on SMP

config FAIR_GROUP_SCHED
    bool "Group scheduling for SCHED_OTHER"
    help
      This feature lets you define CPU bandwidth allocation for groups.

config RT_GROUP_SCHED
    bool "Group scheduling for SCHED_RR/FIFO"
    depends on FAIR_GROUP_SCHED
    help
      This feature lets you define CPU bandwidth allocation for RT groups.

endmenu
```

## tests/fixtures/mini-kernel/mm/Kconfig
```kconfig
config MMU
    bool "Memory Management Unit"
    default y
    help
      This option enables the memory management unit.

config SWAP
    bool "Support for paging of anonymous memory (swap)"
    depends on MMU
    help
      This option allows you to choose whether to support swapping.

config NUMA
    bool "NUMA Memory Allocation and Scheduler Support"
    depends on SMP
    help
      This option enables NUMA support.

config NUMA_BALANCING
    bool "NUMA_BALANCING"
    depends on NUMA
    help
      This option enables automatic NUMA balancing.

config COMPACTION
    bool "Allow for memory compaction"
    help
      This option enables memory compaction.

config MIGRATION
    bool "Page migration"
    depends on NUMA || COMPACTION
    help
      This option enables page migration.

config KSM
    bool "Enable KSM for page merging"
    depends on MMU
    help
      This option enables the kernel samepage merging.

config DEFAULT_MMAP_MIN_ADDR
    hex "Low address space to protect from user allocation"
    default 4096
    help
      This option sets the minimum address for mmap.
```

## tests/fixtures/mini-kernel/net/Kconfig
```kconfig
config NET
    bool "Networking support"
    help
      This option enables networking support.

config INET
    bool "TCP/IP networking"
    depends on NET
    help
      This option enables TCP/IP networking.

config NETFILTER
    bool "Network packet filtering framework (Netfilter)"
    depends on NET
    help
      This option enables Netfilter.

config IP_NF_IPTABLES
    bool "IP tables support"
    depends on NETFILTER
    help
      This option enables IP tables.

config TCP_CONG_ADVANCED
    bool "Advanced TCP congestion controls"
    depends on INET
    help
      This option enables advanced TCP congestion control algorithms.

config TCP_CONG_BIC
    bool "Binary Increase Congestion (BIC) control"
    depends on TCP_CONG_ADVANCED
    help
      This option enables BIC TCP.

config TCP_CONG_CUBIC
    bool "CUBIC TCP"
    default y
    depends on TCP_CONG_ADVANCED
    help
      This option enables CUBIC TCP.

config NET_RX_BUSY_POLL
    bool "Busy polling on sockets"
    depends on NET
    help
      This option enables busy polling on sockets for low latency.
```
